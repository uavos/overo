## build/conf/local.conf
```bitbake
DISTRO = "angstrom-2008.1"

#
# Comment out *one* of the two lines below
#DISTRO_TYPE = "debug"
DISTRO_TYPE = "release"

#
# The default build uses glibc
# Uncomment the line below if you want uclibc instead of glibc
# be prepared for a lot of package breakage!
#ANGSTROM_MODE = "uclibc"

#
# If you enable glibc and encounter qemu-native build issues
# uncomment the line below.
ENABLE_BINARY_LOCALE_GENERATION=1
GLIBC_GENERATE_LOCALES = "en_US.UTF-8"

#HTTP_PROXY="http://judieba:1601@proxy.kacst.edu.sa:8080/"
#FTP_PROXY="http://judieba:1601@proxy.kacst.edu.sa:8080/"
```

## user.collection/conf/machine/overo.conf
```bitbake
#@TYPE: Machine
#@NAME: overo machine for APx
#@DESCRIPTION: Machine configuration for the Gumstix Overo (APx)

require conf/machine/include/omap3.inc

TARGET_ARCH = "arm"

PREFERRED_PROVIDER_virtual/bootloader = "u-boot-omap3"
UBOOT_MACHINE = "omap3_overo_config"

#PREFERRED_PROVIDER_virtual/kernel = "linux-omap3"
PREFERRED_PROVIDER_virtual/kernel = "linux-omap-pm"

IMAGE_FSTYPES += "tar.bz2"

SERIAL_CONSOLE = "115200 ttyS2"

ANGSTROM_URI = "http://www.uavos.com"

# do ubiattach /dev/ubi_ctrl -m 4
# From dmesg:
# UBI: smallest flash I/O unit:    2048
# UBI: logical eraseblock size:    129024 bytes
# from ubiattach stdout:
# UBI device number 0, total 1996 LEBs
MKUBIFS_ARGS = "-m 2048 -e 129024 -c 1996"

# do ubiattach /dev/ubi_ctrl -m 4
# from dmesg:
# UBI: smallest flash I/O unit:    2048
# UBI: physical eraseblock size:   131072 bytes (128 KiB)
# UBI: sub-page size:              512
UBINIZE_ARGS = "-m 2048 -p 128KiB -s 512"

MACHINE_EXTRA_RRECOMMENDS = " kernel-modules"
#MACHINE_EXTRA_RRECOMMENDS += " omap3-sgx-modules"
#MACHINE_EXTRA_RRECOMMENDS += " dsplink-module ti-cmemk-module"
MACHINE_FEATURES = "kernel26 apm ext2 usbgadget usbhost vfat"
```
